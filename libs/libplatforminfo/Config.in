## libs/libplatforminfo/Config.in
```kconfig
menu "Configuration"
	depends on PACKAGE_libplatforminfo

config LIBPLATFORMINFO_CUSTOM
	bool "Use custom definitions"
	default n
	help
		Use custom definitions to get the platform informations
		from special files.

if LIBPLATFORMINFO_CUSTOM

config LIBPLATFORMINFO_BOARD_NAME
	string "File to board name information"
	default "/tmp/sysinfo/board_name"
	help
		File to board name information

config LIBPLATFORMINFO_MODEL
	string "File to model information"
	default "/tmp/sysinfo/model"
	help
		File to model information

config LIBPLATFORMINFO_IMAGE_NAME
	string "File to image name information"
	default ""
	help
		File to image name information

endif # if LIBPLATFORMINFO_CUSTOM

endmenu
```

## net/batman-adv-legacy/Config.in
```kconfig
config KMOD_BATMAN_ADV_LEGACY_DEBUG_LOG
	bool "enable verbose debug logging"
	depends on PACKAGE_kmod-batman-adv-legacy
	default n

config KMOD_BATMAN_ADV_LEGACY_BLA
	bool "enable bridge loop avoidance"
	depends on PACKAGE_kmod-batman-adv-legacy
	default y

config KMOD_BATMAN_ADV_LEGACY_DAT
	bool "enable distributed arp table"
	depends on PACKAGE_kmod-batman-adv-legacy
	default y

config KMOD_BATMAN_ADV_LEGACY_NC
	bool "enable network coding [requires promisc mode support]"
	depends on PACKAGE_kmod-batman-adv-legacy
	default n

config KMOD_BATMAN_ADV_LEGACY_BATCTL
	bool "enable batctl"
	depends on PACKAGE_kmod-batman-adv-legacy
	default y
	help
	  batctl is a more intuitive managment utility for B.A.T.M.A.N.-Advanced.
	  It is an easier method for configuring batman-adv and
	  provides some additional tools for debugging as well.
```

## net/fastd/Config.in
```kconfig
menu "Configuration"
	depends on PACKAGE_fastd

config FASTD_ENABLE_METHOD_XSALSA20_POLY1305
	bool "Enable xsalsa20-poly1305 method"
	depends on PACKAGE_fastd
	default y

config FASTD_ENABLE_METHOD_AES128_GCM
	bool "Enable aes128-gcm method"
	depends on PACKAGE_fastd
	select FASTD_ENABLE_CRYPTO_AES128CTR_NACL if !FASTD_ENABLE_CRYPTO_AES128CTR_LINUX
	select FASTD_ENABLE_CRYPTO_GHASH_BUILTIN if !FASTD_ENABLE_CRYPTO_GHASH_LINUX
	default n

config FASTD_ENABLE_CRYPTO_AES128CTR_NACL
	bool "Include the AES128-CTR implementation from the NaCl library"
	depends on FASTD_ENABLE_METHOD_AES128_GCM
	default y

config FASTD_ENABLE_CRYPTO_AES128CTR_LINUX
	bool "Support using the AES128-CTR implementation in the Linux kernel"
	depends on FASTD_ENABLE_METHOD_AES128_GCM
	default y

config FASTD_ENABLE_CRYPTO_GHASH_BUILTIN
	bool "Include the built-in GHASH implementation"
	depends on FASTD_ENABLE_METHOD_AES128_GCM
	default y

config FASTD_ENABLE_CRYPTO_GHASH_LINUX
	bool "Support using the GHASH implementation in the Linux kernel"
	depends on FASTD_ENABLE_METHOD_AES128_GCM
	default y

endmenu
```
